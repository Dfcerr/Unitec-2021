#include "talkie.h"

Talkie voice;

#define boton_1 6
#define boton_2 7

const uint8_t Azul [] PROGMEM = {0x47,0xAD,0x21,0xC2,0x46,0xAC,0x1C,0xAD,0xC4,0x48,0x1F,0xB1,0x7D,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0x29,0x3C};
const uint8_t Cuidado[] PROGMEM = {0x48,0xAB,0xB2,0x23,0xD4,0x1D,0x0B,0x29,0xAD,0x55,0x8F,0xB0,0xA3,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0xC3,0x03};
const uint8_t Modo_ahorro_activado[] PROGMEM = {0x00,0x00,0x00,0x00,0x00,0x00,0x00,0x00,0x00,0x00,0x00,0x20,0x54,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0x00,0xF0};
const uint8_t Modo_ahorro_desactivado[] PROGMEM = {0x46,0xC5,0xB9,0xAC,0xB2,0x92,0x18,0x85,0xA4,0x90,0xCE,0x6C,0x1A,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0x4B,0xF2};
const uint8_t Porciento[] PROGMEM = {0xE0,0x94,0x6A,0xDD,0xCD,0x2D,0x4E,0x52,0x7D,0x6A,0xA7,0x5C,0xB9,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0xDB,0x0F};
const uint8_t Rojo[] PROGMEM = {0x4D,0x8C,0x49,0x2A,0xC7,0xAB,0x0C,0x31,0x64,0xCD,0x9C,0x88,0xBB,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0xA5,0x3C};
const uint8_t Verde[] PROGMEM = {0x4C,0x85,0xA9,0xBD,0xAB,0x22,0x09,0x15,0xE6,0x8E,0xCA,0x8A,0x1C,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0xC0,0x03};
const uint8_t SCCB[] PROGMEM = {0x4C,0xE9,0x31,0x39,0x42,0x6D,0xA1,0xA0,0xC7,0x51,0xCF,0xB0,0x88,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0x48,0xFC};
const uint8_t SDCB[] PROGMEM = {0x44,0xED,0x3E,0x25,0xCD,0x1C,0xA1,0xB3,0xA7,0x55,0x73,0xB7,0x88,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0xDB,0xF6};

byte palabra = 1;
bool clv = 0;
void setup() 
{
    Serial.begin(9600);
    pinMode(boton_1, INPUT_PULLUP);
    pinMode(boton_2, INPUT_PULLUP);
}
void loop()
{
    if(!digitalRead(boton_1))
    {
        palabra++;
        clv = 1;
    }
    else if(!digitalRead(boton_2))
    {
        palabra--;
        clv = 1;
    }

    if(palabra < 1)
        palabra = 10;
    else if(palabra > 10)
        palabra = 1;
    
    if(clv)
    {
        switch (palabra)
        {
        case 1:
            num();
            break;
        case 2:
            Serial.println("Porciento");
            voice.say(Porciento);
            break;
        case 3:
            Serial.println("Rojo");
            voice.say(Rojo);
            break;
        case 4:
            Serial.println("Verde");
            voice.say(Verde);
            break;
        case 5:
            Serial.println("Azul");
            voice.say(Azul);
            break;
        case 6:
            Serial.println("Se a conectado el cargador de la bateria");
            voice.say(SCCB);
            break;
        case 7:
            Serial.println("se a desconectado el cargador de la bateria");
            voice.say(SDCB);
            break;
        case 8:
            Serial.println("Modo ahorro activado");
            voice.say(Modo_ahorro_activado);
            break;
        case 9:
            Serial.println("Modo ahorro desactivado");
            voice.say(Modo_ahorro_desactivado);
            break;
        case 10:
            Serial.println("CUIDADO!!");
            voice.say(Cuidado);
            break;
        }

        clv = 0;
    }

    delay(200);
}

void num()
{
    byte aux, d_1, d_2, d_3;
    byte nu, normal = 0, y = 1;
    nu = map(analogRead(A5), 0, 1024, 0, 100);
    Serial.println(nu);

    aux = nu / 100;
    d_1 = aux;

    aux = nu - (d_1 * 100);
    d_2 = aux /10;

    d_3 = nu - (d_2 * 10);

    switch (nu)
    {
    case 100:
        Serial.print("cien");
        break;
    case 20:
        Serial.print("viente");
        break;
    case 15:
        Serial.print("quince");
        break;
    case 14:
        Serial.print("catorce");
        break;
    case 13:
        Serial.print("trece");
        break;
    case 12:
        Serial.print("doce");
        break;
    case 11:
        Serial.print("once");
        break;
    case 10:
        Serial.print("diez");
        break;
    case 0:
        Serial.print("cero");
        break;
    default:
        normal = 1;
        break;
    }

    if(normal)
    {
//------------------------------------------------
//      decenas
//------------------------------------------------
        switch (d_2)
        {
        case 9:
            Serial.print("noventa");
            break;
        case 8:
            Serial.print("ochenta");
            break;
        case 7:
            Serial.print("setenta");
            break;
        case 6:
            Serial.print("sesenta");
            break;
        case 5:
            Serial.print("cincuenta");
            break;
        case 4:
            Serial.print("cuarenta");
            break;
        case 3:
            Serial.print("treinta");
            break;
        case 2:
            Serial.print("veinti ");
            y = 0;
            break;
        case 1:
            Serial.print("diesi ");
            y = 0;
            break;
        default:
            y = 0;
            break;
        }
//------------------------------------------------
//      usar y?
//------------------------------------------------        
        if(d_3 == 0)
            y = 0;
            
        if(y)
            Serial.print(" y ");
//------------------------------------------------
//      unidades
//------------------------------------------------
        switch (d_3)
        {
        case 9:
            Serial.print("nueve");
            break;
        case 8:
            Serial.print("ocho");
            break;
        case 7:
            Serial.print("siete");
            break;
        case 6:
            Serial.print("sies");
            break;
        case 5:
            Serial.print("cinco");
            break;
        case 4:
            Serial.print("cuatro");
            break;
        case 3:
            Serial.print("tres");
            break;
        case 2:
            Serial.print("dos");
            break;
        case 1:
            Serial.print("uno");
            break;
        default:
            break;
        }
    }
    Serial.println(" porciento");

}